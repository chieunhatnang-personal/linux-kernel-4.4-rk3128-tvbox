// SPDX-License-Identifier: (GPL-2.0+ OR MIT)
/*
 * Force a fixed 700 MHz DDR clock on RK3128.
 * Effective DDR data rate is 1400 MT/s.
 */

/dts-v1/;
/plugin/;

#include <dt-bindings/soc/rockchip-system-status.h>

/ {
	fragment@0 {
		target = <&dmc>;
		__overlay__ {
			status = "okay";
			auto-freq-en = <0>;
			system-status-freq = <SYS_STATUS_NORMAL 700000>;
			dram_freq = <700000000>;
		};
	};

	fragment@1 {
		target = <&dmc_opp_table>;
		__overlay__ {
			opp-700000000 {
				status = "okay";
			};
		};
	};
};
