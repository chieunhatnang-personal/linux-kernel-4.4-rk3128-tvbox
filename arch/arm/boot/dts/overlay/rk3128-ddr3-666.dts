// SPDX-License-Identifier: (GPL-2.0+ OR MIT)
/*
 * Force a fixed 666 MHz DDR clock on RK3128.
 * Effective DDR data rate is 1332 MT/s.
 */

/dts-v1/;
/plugin/;

#include <dt-bindings/soc/rockchip-system-status.h>

/ {
	fragment@0 {
		target = <&dmc>;
		__overlay__ {
			status = "okay";
			auto-freq-en = <0>;
			system-status-freq = <SYS_STATUS_NORMAL 666000>;
			dram_freq = <666000000>;
		};
	};

	fragment@1 {
		target = <&dmc_opp_table>;
		__overlay__ {
			opp-666000000 {
				status = "okay";
			};
		};
	};
};
